## drivers/sensor/vcnl4035/Kconfig
```kconfig
# VCNL4035 Proximity and Ambient Light Sensor configuration options

# Copyright (c) 2023 Felix Baral-Weber
# SPDX-License-Identifier: Apache-2.0

menuconfig VCNL4035
	bool "VCNL4035 Proximity and Ambient Light Sensor"
	default y
	depends on DT_HAS_VISHAY_VCNL4035_ENABLED
	select I2C
	help
	  Enable driver for VCNL4035 sensors.

if VCNL4035

config VCNL4035_ENABLE_ALS
	bool "Ambient light sensor"
	help
	  Enable Ambient Light Sense (ALS).

config VCNL4035_TRIGGER
	bool

choice
	prompt "Trigger mode"
	default VCNL4035_TRIGGER_NONE
	help
	  Specify the type of triggering to be used by the driver.

config VCNL4035_TRIGGER_NONE
	bool "No trigger"

config VCNL4035_TRIGGER_GLOBAL_THREAD
	bool "Use global thread"
	depends on GPIO
	select VCNL4035_TRIGGER

config VCNL4035_TRIGGER_OWN_THREAD
	bool "Use own thread"
	depends on GPIO
	select VCNL4035_TRIGGER

endchoice

config VCNL4035_THREAD_PRIORITY
	int "Thread priority"
	depends on VCNL4035_TRIGGER_OWN_THREAD
	default 10
	help
	  Priority of thread used by the driver to handle interrupts.

config VCNL4035_THREAD_STACK_SIZE
	int "Thread stack size"
	depends on VCNL4035_TRIGGER_OWN_THREAD
	default 1024
	help
	  Stack size of thread used by the driver to handle interrupts.

endif # VCNL4035
```
